## config/west.yml
```yaml
manifest:
  remotes:
    - name: zmkfirmware
      url-base: https://github.com/zmkfirmware
  projects:
    - name: zmk
      remote: zmkfirmware
      # Upgrade from v0.3 to at least v0.4 (or a newer tag, e.g. v0.5, v0.6, or `main`)
      revision: v0.4 # <-- NEW
      import: app/west.yml
  self:
    path: config
```
